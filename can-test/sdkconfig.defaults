## can-test/sdkconfig.defaults
```kconfig
CONFIG_FREERTOS_HZ=1000
CONFIG_TWAI_ISR_IN_IRAM=y
CONFIG_ESPTOOLPY_FLASHSIZE_16MB=y
CONFIG_ESPTOOLPY_FLASHSIZE="16MB"
CONFIG_SPIRAM=y
CONFIG_SPIRAM_MODE_OCT=y
CONFIG_SPIRAM_TYPE_AUTO=y
CONFIG_SPIRAM_SPEED_40M=y
# CONFIG_SPIRAM_SPEED_80M is not set
CONFIG_SPIRAM_USE_MALLOC=y
CONFIG_SPIRAM_BOOT_INIT=y
CONFIG_SPIRAM_BOOT_HW_INIT=y
# CONFIG_SPIRAM_MEMTEST is not set
CONFIG_SPIRAM_IGNORE_NOTFOUND=y
CONFIG_ESP_CONSOLE_USB_SERIAL_JTAG=y
# CONFIG_ESP_CONSOLE_UART_DEFAULT is not set
CONFIG_ESP_CONSOLE_USB_SERIAL_JTAG_ENABLED=y
```

## cockpit_hmi_esp32/firmware/sdkconfig.defaults
```kconfig
# Target Selection
CONFIG_IDF_TARGET="esp32s3"

# CPU Frequency (240 MHz)
CONFIG_ESP_DEFAULT_CPU_FREQ_MHZ_240=y
CONFIG_ESP_DEFAULT_CPU_FREQ_MHZ=240

# Flash configuration (16 MB Quad SPI)
CONFIG_ESPTOOLPY_FLASHSIZE_16MB=y
CONFIG_ESPTOOLPY_FLASHSIZE="16MB"
CONFIG_ESPTOOLPY_FLASHMODE_QIO=y

# PSRAM Configuration (8 MB Octal PSRAM for RGB framebuffers)
CONFIG_SPIRAM=y
CONFIG_SPIRAM_MODE_OCT=y
CONFIG_SPIRAM_TYPE_AUTO=y
CONFIG_SPIRAM_SPEED_80M=y
CONFIG_SPIRAM_USE_MALLOC=y
CONFIG_SPIRAM_MEMTEST=y

# FreeRTOS configuration
CONFIG_FREERTOS_HZ=1000

# TWAI (CAN Bus) Configuration
CONFIG_TWAI_ISR_IN_IRAM=y

# LVGL Memory Configuration
CONFIG_LV_COLOR_DEPTH_16=y
CONFIG_LV_COLOR_16_SWAP=0
CONFIG_LV_MEM_CUSTOM=y
CONFIG_LV_TICK_CUSTOM=y
CONFIG_LV_USE_PERF_MONITOR=y
CONFIG_LV_FONT_MONTSERRAT_10=y
CONFIG_LV_FONT_MONTSERRAT_12=y
CONFIG_LV_FONT_MONTSERRAT_14=y
CONFIG_LV_FONT_MONTSERRAT_20=y
CONFIG_LV_FONT_MONTSERRAT_24=y
CONFIG_LV_FONT_MONTSERRAT_48=y
```

## rm-esp32-legacy/sdkconfig.defaults
```kconfig
CONFIG_FREERTOS_HZ=1000
CONFIG_TWAI_ISR_IN_IRAM=y
CONFIG_ESP_CONSOLE_UART_DEFAULT=y
CONFIG_ESP_CONSOLE_UART_BAUDRATE=115200
```
